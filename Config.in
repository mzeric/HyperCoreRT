## Config.in
```kconfig
mainmenu "HyperCoreRT Configuration"

source src/arch/Config.in
source src/core/Config.in
```

## src/arch/Config.in
```kconfig
choice
	prompt "Target Architecture"
	default CONFIG_ARCH_AARCH64
	help
	  The architecture of your target.

config CONFIG_ARCH_AARCH64
	bool "AArch64"
	help
	 ARM support

config CONFIG_ARCH_RISCV64
	bool "RISCV64"
	help
	  RISC-V support.

endchoice

if CONFIG_ARCH_AARCH64
source "src/arch/aarch64/Config.in"
endif

if CONFIG_ARCH_RISCV64
source "src/arch/riscv64/Config.in"
endif
```

## src/arch/aarch64/Config.in
```kconfig
config CONFIG_SMP
    bool "multiprocessor support"
    default y
    depends on CONFIG_ARCH_AARCH64
    help
        if Target arch suport smp

if CONFIG_SMP

config CONFIG_SMP_CPU_NUM
    int "CPU number"
    range 1 16
    default 4
endif

config CONFIG_PAGE_SHIFT
    int "memory page shift"
    range 10 50
    default 12
config CONFIG_PADDR_BITS
    int "physical address bits"
    range 1 50
    default 44
config CONFIG_DTB_LOAD_PHYS_ADDR
    hex "dtb(Device Tree) load address without bootloader"
    default 0x40000000

choice
	prompt "Platform Board"
	default CONFIG_BOARD_FVP_AEMVA
	help
		Target board

config CONFIG_BOARD_QEMU_VIRT
	bool "Qemu Virt"

config CONFIG_BOARD_FVP_AEMVA
	bool "FVP AEMvA"


endchoice
```

## src/core/Config.in
```kconfig
menu "Core Options"
comment "configurations"



config CONFIG_INT_STACK_SIZE
	int "interrupt stack size"
	default 4096

config CONFIG_ENTRY_ADDR
	hex "entry addr"
	default 0x40000000

config CONFIG_PHY_MEM_SIZE
	hex "physical memory size"
	default 0x800000
config CONFIG_HOST_USE_2MB_MAPPING
	bool "use 2MB page-mapping for hypervisor self"
	default False
endmenu
```
